## config/boards/bybor/mriya/board.yml
```yaml
boards:
  - name: mriya_left
    vendor: bybor
    socs:
      - name: nrf52840
        variants:
          - name: zmk
  - name: mriya_right
    vendor: bybor
    socs:
      - name: nrf52840
        variants:
          - name: zmk
```
